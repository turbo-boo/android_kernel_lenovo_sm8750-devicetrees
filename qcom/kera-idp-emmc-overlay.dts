// SPDX-License-Identifier: BSD-3-Clause
/*
 * Copyright (c) Qualcomm Technologies, Inc. and/or its subsidiaries.
 */

/dts-v1/;
/plugin/;

#include "kera-idp-emmc.dtsi"
#include "kera-pmiv0102.dtsi"

/ {
	model = "Qualcomm Technologies, Inc. Kera IDP + eMMC";
	compatible = "qcom,kera-idp", "qcom,kera", "qcom,kerap-idp", "qcom,kerap",
			"qcom,idp", "qcom,kerap-qna";
	qcom,msm-id = <686 0x10000>, <721 0x10000>;
	qcom,board-id = <0x10022 0>, <0x30022 0>;
};
