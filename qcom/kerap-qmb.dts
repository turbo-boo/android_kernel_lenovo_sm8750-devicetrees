// SPDX-License-Identifier: BSD-3-Clause
/*
 * Copyright (c) Qualcomm Technologies, Inc. and/or its subsidiaries.
 */

/dts-v1/;

#include "kerap-qmb.dtsi"

/ {
	model = "Qualcomm Technologies, Inc. KeraP QMB SoC";
	compatible = "qcom,kerap-qmb";
	qcom,board-id = <0 0>;
};
